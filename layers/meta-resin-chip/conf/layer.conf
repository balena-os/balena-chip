## layers/meta-resin-chip/conf/layer.conf
```bitbake
BBPATH .= ":${LAYERDIR}"

BBFILES += "${LAYERDIR}/recipes-*/*/*.bb \
            ${LAYERDIR}/recipes-*/*/*.bbappend"

BBFILE_COLLECTIONS += "resin-chip"
BBFILE_PATTERN_resin-chip := "^${LAYERDIR}/"
BBFILE_PRIORITY_resin-chip = "1337"
```
